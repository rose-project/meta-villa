## conf/distro/villa-os.conf
```bitbake
# Villa OS distribution
DISTRO_NAME = "VillaOS"
DISTRO_VERSION = "0.1"

LOCALCONF_VERSION ?= "1"
LAYER_CONF_VERSION ?= "1"

DISTRO_FEATURES = "${DISTRO_FEATURES_DEFAULT} ${DISTRO_FEATURES_LIBC} sysvinit opengl egl pam wayland"
DISTRO_FEATURES_BACKFILL_CONSIDERED = "sysvinit"
VIRTUAL-RUNTIME_init_manager = "sysvinit"

DISTRO_EXTRA_RDEPENDS = ""
DISTRO_EXTRA_RRECOMMENDS = ""
```

## conf/layer.conf
```bitbake
# We have a conf and classes directory, add to BBPATH
BBPATH .= ":${LAYERDIR}"

# We have recipes-* directories, add to BBFILES
BBFILES += "${LAYERDIR}/recipes-*/*/*.bb \
	${LAYERDIR}/recipes-*/*/*.bbappend"

BBFILE_COLLECTIONS += "villa"
BBFILE_PATTERN_villa = "^${LAYERDIR}/"
BBFILE_PRIORITY_villa = "10"

LAYERDEPENDS_villa = "rose"
```

## recipes-core/images/villa-base-image.wks
```
# short-description: Create SD card image for the Raspberry Pi
# long-description: Creates a partitioned SD card image. Boot files
# are located in the first vfat partition.

part /boot --source bootimg-partition --ondisk mmcblk0 --fstype=vfat --label boot --active --align 1024 --size 64
part / --source rootfs --ondisk mmcblk0 --fstype=ext4 --label root --align 1024 --size 500
```
